## esp32/main/Kconfig.projbuild
```kconfig
menu "Streaming Configuration"

config WIFI_SSID
    string "WiFi SSID"

config WIFI_PASSWORD
    string "WiFi Password"

config SERVER_IP
    string "UDP Server IP"

config SERVER_FRAME_PORT
    int "UDP Frame Port"

config DEVICE_CONTROL_PORT
    int "Device Control Port"

config UDP_HANDSHAKE_MAX_RETRIES
    int "UDP Handshake Max Retries"

config UDP_HANDSHAKE_PING_INTERVAL_MS
    int "UDP Handshake Ping Interval (ms)"

config UDP_ALIVE_TIMEOUT_MS
    int "UDP Alive Timeout (ms)"

config UDP_HANDSHAKE_TIMEOUT_MS
    int "UDP Handshake Timeout (ms)"

config CAMERA_CAPTURE_RATE_FPS
    int "Camera Capture Rate (fps)"

config FRAMESIZE
    int "Camera Frame Size"

config JPEG_QUALITY
    int "Camera JPEG Quality"

config XCLK_FREQ_HZ
    int "Camera XCLK Frequency (Hz)"

endmenu
```

## esp32/sdkconfig.defaults
```kconfig
# -- Target --
CONFIG_IDF_TARGET="esp32s3"

# -- Memory and CPU --
CONFIG_SPIRAM=y
CONFIG_SPIRAM_MODE_OCT=y
CONFIG_SPIRAM_SPEED_40M=y
CONFIG_SPIRAM_USE_MALLOC=y
CONFIG_ESP32S3_DEFAULT_CPU_FREQ_240=y

# -- UDP --
CONFIG_SERVER_FRAME_PORT=5005
CONFIG_DEVICE_CONTROL_PORT=5006
CONFIG_UDP_HANDSHAKE_MAX_RETRIES=60
CONFIG_UDP_HANDSHAKE_PING_INTERVAL_MS=1000
CONFIG_UDP_ALIVE_TIMEOUT_MS=1000
CONFIG_UDP_HANDSHAKE_TIMEOUT_MS=6000000

# -- Camera --
CONFIG_CAMERA_CAPTURE_RATE_FPS=30
CONFIG_FRAMESIZE=5
CONFIG_JPEG_QUALITY=20
CONFIG_XCLK_FREQ_HZ=20000000
```
